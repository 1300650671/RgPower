## Kconfig
```kconfig
# Kconfig file for package RgPower
menuconfig PKG_USING_RGPOWER
    bool " Use RgPower "
    default n

if PKG_USING_RGPOWER

    config PKG_RGPOWER_PATH
        string 
        default "/packages/peripherals/RgPower"

    config RGPOWER_USEING_LOG
        bool "open debug log"
        default n

    config RGPOWER_POWER_OFF_PIN_NUM
        int "This value is the gpio num for power off"
        default 22
        help
            关机引脚

    config RGPOWER_CHARGE_PIN_NUM
        int "This value is the gpio num for charge status"
        default 5
        help
            充电检测引脚

    config RGPOWER_CHARGE_GPIO_STATUS
        int "This value is the gpio charge status"
        default 1
        help
            如果充电时电压为高电平即为1,如果充电时电压为低电平即为0

    config RGPOWER_ADC_DEV_NAME
        string "adc device name"
        default "adc3"

    config RGPOWER_ADC_DEV_CHANNEL
        int "This value is adc channel"
        default 11

    config RGPOWER_REFER_VOLTAGE
        int "This value is adc refere voltage (mv)"
        default 3300

    config RGPOWER_CONVERT_BITS_MAX
        int "This value is adc bits max value"
        default 4096

    config RGPOWER_SCALE_FACTOR
        int "This value is voltage (mv) scale factor"
        default 3

    config RGPOWER_100_VOLTAGE
        int "This value is voltage (mv) for 100%"
        default 4200

    config RGPOWER_0_VOLTAGE
        int "This value is voltage (mv) for 0%"
        default 3500

    

    choice
        prompt "Version"
        default PKG_USING_RGPOWER_LATEST_VERSION
        help
            Select the package version

        config PKG_USING_RGPOWER_V102
            bool "v1.0.2"

        config PKG_USING_RGPOWER_LATEST_VERSION
            bool "latest"
    endchoice

    config PKG_RGPOWER_VER
       string
       default "v1.0.2"    if PKG_USING_RGPOWER_V102
       default "latest"    if PKG_USING_RGPOWER_LATEST_VERSION

endif
```
